## boards/alertrax/alertrax/Kconfig.alertrax51
```kconfig
# AlerTrax nRF91 V2 configuration

# Copyright (c) 2018-2022 Nordic Semiconductor ASA
# Copyright (c) 2022 NautAlert, LLC.
# SPDX-License-Identifier: Apache-2.0

config BOARD_ALERTRAX51
	select SOC_NRF9151_LACA
```

## boards/alertrax/alertrax/Kconfig.alertrax60
```kconfig
# AlerTrax nRF91 V2 configuration

# Copyright (c) 2018-2022 Nordic Semiconductor ASA
# Copyright (c) 2022 NautAlert, LLC.
# SPDX-License-Identifier: Apache-2.0

config BOARD_ALERTRAX60
	select SOC_NRF9160_SICA
```

## boards/alertrax/alertrax/Kconfig.alertrax61
```kconfig
# AlerTrax nRF91 V2 configuration

# Copyright (c) 2018-2022 Nordic Semiconductor ASA
# Copyright (c) 2022 NautAlert, LLC.
# SPDX-License-Identifier: Apache-2.0

config BOARD_ALERTRAX61
	select SOC_NRF9161_LACA
```

## boards/alertrax/alertrax/Kconfig.defconfig
```kconfig
# AlerTrax nRF91 V3 configuration

# Copyright (c) 2018-2022 Nordic Semiconductor ASA
# Copyright (c) 2022 NautAlert, LLC.
# SPDX-License-Identifier: Apache-2.0

if BOARD_ALERTRAX60_NRF9160 || BOARD_ALERTRAX60_NRF9160_NS || BOARD_ALERTRAX61_NRF9161 || BOARD_ALERTRAX61_NRF9161_NS || BOARD_ALERTRAX51_NRF9151 || BOARD_ALERTRAX51_NRF9151_NS

if BOARD_ALERTRAX60_NRF9160 || BOARD_ALERTRAX60_NRF9160_NS
config BOARD
	default "alertrax60_nrf9160"
endif
if BOARD_ALERTRAX61_NRF9161 || BOARD_ALERTRAX61_NRF9161_NS
config BOARD
	default "alertrax61_nrf9161"
endif
if BOARD_ALERTRAX51_NRF9151 || BOARD_ALERTRAX51_NRF9151_NS
config BOARD
	default "alertrax51_nrf9151"
endif

config BUILD_WITH_TFM
	default y if BOARD_ALERTRAX60_NRF9160_NS || BOARD_ALERTRAX61_NRF9161_NS || BOARD_ALERTRAX51_NRF9151_NS

if BUILD_WITH_TFM

# By default, if we build with TF-M, instruct build system to
# flash the combined TF-M (Secure) & Zephyr (Non Secure) image
config TFM_FLASH_MERGED_BINARY
	bool
	default y

endif # BUILD_WITH_TFM
# For the secure version of the board the firmware is linked at the beginning
# of the flash, or into the code-partition defined in DT if it is intended to
# be loaded by MCUboot. If the secure firmware is to be combined with a non-
# secure image (TRUSTED_EXECUTION_SECURE=y), the secure FW image shall always
# be restricted to the size of its code partition.
# For the non-secure version of the board, the firmware
# must be linked into the code-partition (non-secure) defined in DT, regardless.
# Apply this configuration below by setting the Kconfig symbols used by
# the linker according to the information extracted from DT partitions.

# Workaround for not being able to have commas in macro arguments
DT_CHOSEN_Z_CODE_PARTITION := zephyr,code-partition

config FLASH_LOAD_SIZE
	default $(dt_chosen_reg_size_hex,$(DT_CHOSEN_Z_CODE_PARTITION))
	depends on (BOARD_ALERTRAX60_NRF9160 || BOARD_ALERTRAX61_NRF9161 || BOARD_ALERTRAX51_NRF9151) && TRUSTED_EXECUTION_SECURE

if BOARD_ALERTRAX60_NRF9160_NS || BOARD_ALERTRAX61_NRF9161_NS || BOARD_ALERTRAX51_NRF9151_NS

config FLASH_LOAD_OFFSET
	default $(dt_chosen_reg_addr_hex,$(DT_CHOSEN_Z_CODE_PARTITION))

config FLASH_LOAD_SIZE
	default $(dt_chosen_reg_size_hex,$(DT_CHOSEN_Z_CODE_PARTITION))

endif # BOARD_ALERTRAX_NRF91_V3_NS

config I2C
	default $(dt_compat_on_bus,$(DT_COMPAT_NXP_PCAL6408A),i2c)

endif # BOARD_ALERTRAX_NRF91_V3 || BOARD_ALERTRAX_NRF91_V3_NS
```

## boards/alertrax/alertrax/alertrax61_nrf9161_defconfig
```kconfig
# SPDX-License-Identifier: Apache-2.0

# Enable MPU
CONFIG_ARM_MPU=y

# Enable TrustZone-M
CONFIG_ARM_TRUSTZONE_M=y

# Hardware stack protection
CONFIG_HW_STACK_PROTECTION=y

# enable GPIO
CONFIG_GPIO=y
```

## boards/alertrax/alertrax/board.yml
```yaml
boards:
- name: alertrax60
  vendor: alertrax
  socs:
  - name: nrf9160
    variants:
    - name: ns
- name: alertrax61
  vendor: alertrax
  socs:
  - name: nrf9161
    variants:
    - name: ns
- name: alertrax51
  vendor: alertrax
  socs:
  - name: nrf9151
    variants:
    - name: ns
  
```

## build/AlexTrax_test_code/Kconfig/boards/Kconfig.defconfig
```kconfig
# Load Zephyr board defconfig descriptions.
osource "/home/abdullah/ncs/v2.9.0/zephyr/boards/nordic/nrf9151dk/Kconfig.defconfig"
```

## build/AlexTrax_test_code/Kconfig/boards/Kconfig.nrf52840dk
```kconfig
# Load board Kconfig descriptions.
osource "/home/abdullah/ncs/v2.9.0/zephyr/boards/nordic/nrf52840dk/Kconfig.nrf52840dk"
```

## build/AlexTrax_test_code/Kconfig/boards/Kconfig.sysbuild
```kconfig
# Load Sysbuild board Kconfig descriptions.
osource "/home/abdullah/ncs/v2.9.0/zephyr/boards/nordic/nrf9151dk/Kconfig.sysbuild"
```

## build/Kconfig/Kconfig.shield
```kconfig
osource "/home/abdullah/Abdullah/Projects/projects/Alertrax_Tracker_Project/Firmware/AlexTrax_test_code/boards/shields/*/Kconfig.shield"
osource "/home/abdullah/ncs/v2.9.0/nrf/boards/shields/*/Kconfig.shield"
```

## build/Kconfig/boards/Kconfig.defconfig
```kconfig
# Load Zephyr board defconfig descriptions.
osource "/home/abdullah/ncs/v2.9.0/zephyr/boards/nordic/nrf52840dk/Kconfig.defconfig"
```
