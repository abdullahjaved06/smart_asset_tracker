/*
 * Copyright (c) 2018-2022 Nordic Semiconductor ASA
 * Copyright (c) 2022 NautAlert, LLC.
 *
 * SPDX-License-Identifier: Apache-2.0
 */

/dts-v1/;
#include <nordic/nrf9160ns_sica.dtsi>
#include "alertrax_common.dtsi"

/ {
	chosen {
		zephyr,flash = &flash0;
		zephyr,sram = &sram0_ns;
		zephyr,code-partition = &slot0_ns_partition;
	};
};

/* Disable UART1, because it is used by default in TF-M */
&uart1 {
	status = "disabled";
};

/* Include partition configuration file */
#include "alertrax60_nrf9160_partition_conf.dtsi"